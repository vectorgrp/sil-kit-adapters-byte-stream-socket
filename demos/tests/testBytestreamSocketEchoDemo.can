/*@!Encoding:65001*/
includes
{
  
}

variables
{
  int result;
  dword timeout = 2000;
  char msg[13] = "test message";
}

export testfunction PrepareTestscenario()
{
  $Namespace::EchoDevice.toSocket = msg;
}

export testcase DO_WaitForSocketMessage()
{
  Namespace::Adapter.Connect();
  result = testWaitForImplValueString(Namespace::Adapter.fromSocket, msg, timeout);
  
  if (result != 1)
  {
    TestStepFail("DO_WaitForSocketMessage", "FAILED: No message matching within timeout");
  }
  TestStepPass("DO_WaitForSocketMessage", "SUCCESS");
}
